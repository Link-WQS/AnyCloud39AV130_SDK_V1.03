/*
 * AK3918AV100 dev board dts
 *
 * Copyright (C) 2020 Anyka(Guangzhou) Microelectronics Technology Co., Ltd.
 *
 * This program is free software; you can redistribute it and/or modify
 * it under the terms of the GNU General Public License as published by
 * the Free Software Foundation; either version 2 of the License, or
 * (at your option) any later version.
 *
 * This program is distributed in the hope that it will be useful,
 * but WITHOUT ANY WARRANTY; without even the implied warranty of
 * MERCHANTABILITY or FITNESS FOR A PARTICULAR PURPOSE.  See the
 * GNU General Public License for more details.
 */

/dts-v1/;
#include "anycloud_km01a.dtsi"
#include "EVB_CBDM_KM01A_DUAL_V1.0.0.dtsi"

/ {
    compatible = "anyka,km01a";
    model = "EVB_CBDM_KM01A_DUAL_V1.0.0 board";
    version = "V1.0.00";
};

// using detect-gpio or detect-gpios
&mmc1 {
    power-inverted;
};

// using detect-gpio or detect-gpios
// &mmc1 {
//     bus-width = <0x4>;
//     max-frequency = <50000000>;
//     //detect-gpio = <&gpio XGPIO_055 1>; 
//     non-removable;
//     cap-sd-highspeed;
//     //pinctrl-names = "default","idle";
//     //pinctrl-0 = <&mci1_pins>,<&tf_en_pins>,<&tf_det_pins>;
//     pinctrl-0 = <&mci1_pins>,<&tf_en_pins>;
//     pinctrl-1 = <&mci1_idle_pins>; 
//     power-pins = <&gpio XGPIO_050 1>; 
//     status = "okay"; 
// };

// cd_clk
/*
&mmc1 {
    power-inverted;
};
*/

//&spi_nor {
//	pinctrl-names = "default";
//    pinctrl-0 = <&spiflash_pins>;
//    //cs-gpios = <&gpio 25 1>;
//	status = "okay";
//};

// cd_d3
/*
&mmc1 {
    power-inverted;
};
*/
