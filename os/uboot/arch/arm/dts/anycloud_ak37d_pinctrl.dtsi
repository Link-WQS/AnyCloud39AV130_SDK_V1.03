/*
 * AK37E SoC
 *
 * Copyright (C) 2020 Anyka(Guangzhou) Microelectronics Technology Co., Ltd.
 *
 * This program is free software; you can redistribute it and/or modify
 * it under the terms of the GNU General Public License as published by
 * the Free Software Foundation; either version 2 of the License, or
 * (at your option) any later version.
 *
 * This program is distributed in the hope that it will be useful,
 * but WITHOUT ANY WARRANTY; without even the implied warranty of
 * MERCHANTABILITY or FITNESS FOR A PARTICULAR PURPOSE.  See the
 * GNU General Public License for more details.
 */

/*
* NOTE:
* This is the common configuration about pinctrl with those customers no need to care about.
* Like the mmc/eth, customers will less to modify them.
* IF your pins are strongly relate on the specifically board.
* Please move them to the board related file.
*/

#include <dt-bindings/pinctrl/ak_37d_pinctrl.h>

&pinctrl {
    /*
    * "anyka,function": func index, please refer to dt-bindings/pinctrl/ak_37d_pinctrl.h
    * "anyka,pull": configuration of the pins
    * bit[7:0]: pull up/down configuration
    *     bit[0]: pull up or pull down selection, 1 means select pull down, 0 means select pull up
    *     bit[4]: pull up or pull down enable, 1 means enable pull up&down function, 0 means disable fuction
    * !!! Notice that not all pin support pull up and pull down. Please refer to the programer's guide.
    * bit[15:8]: driver strength configuration.
    *     bit[9:8] drive strength.
    * bit[23:16]: input enable configuration
    *     bit[16]: 1 means enable input, 0 means disable input.
    * bit[31:24]: pin slew rate configuration
    *     bit[24]: 1 means enable slew rate, 0 means disable slew rate.
    * !!! Notice OTHER bits which not mentioned please set to 0.
    */

    uart0_pins: uart0_pins {
        anyka,pins = <XGPIO_001 XGPIO_002>;
        anyka,function = <XGPIO_001_FUNC_UART0_RXD XGPIO_002_FUNC_UART0_TXD>;
        anyka,pull = <0x01010010>;
    };

    uart1_pins: uart1_pins {
        anyka,pins = <XGPIO_036 XGPIO_037>;
        anyka,function = <XGPIO_036_FUNC_UART1_RXD XGPIO_037_FUNC_UART1_TXD>;
        anyka,pull = <0x01010010>;
    };

    spiflash_pins: spiflash_pins {
        anyka,pins = <XGPIO_012
                        XGPIO_082
                        XGPIO_067
                        XGPIO_068
                        XGPIO_069
                        XGPIO_070
                        >;
        anyka,function = <XGPIO_012_FUNC_SPI0_CS
                            XGPIO_082_FUNC_GPIO82
                            XGPIO_067_FUNC_SPI0_DIN
                            XGPIO_068_FUNC_SPI0_DOUT
                            XGPIO_069_FUNC_SPI0_WP
                            XGPIO_070_FUNC_SPI0_HOLD
                    >;
        anyka,pull = <0x01010010>;
    };

};
