/*
 * Anycloud LCD panel dts
 *
 * Copyright (C) 2018 Anyka(Guangzhou) Microelectronics Technology Co., Ltd.
 *
 * Author: Feilong Dong <dong_feilong@anyka.com>
 *
 * This program is free software; you can redistribute it and/or modify
 * it under the terms of the GNU General Public License as published by
 * the Free Software Foundation; either version 2 of the License, or
 * (at your option) any later version.
 *
 * This program is distributed in the hope that it will be useful,
 * but WITHOUT ANY WARRANTY; without even the implied warranty of
 * MERCHANTABILITY or FITNESS FOR A PARTICULAR PURPOSE.  See the
 * GNU General Public License for more details.
 */
&lcdc {
    lcd-alarm-empty = <128>;
    lcd-alarm-full = <510>;
    lcd-dma-mode = <1>;
    //lcd-dummy-seq = <0>; //for 8bit rgb panel set
    //lcd-rgb-seq-sel = <0>;
    //lcd-rgb-odd-seq = <0>;
    //lcd-rgb-even-seq = <0>;
    lcd-rgb-tpg-sel = <1>;
    lcd-vpage-en = <0>; //don't support vpage function in driver
    lcd-blank-sel = <0>;
    lcd-pos-blank-level = <0>;
    lcd-neg-blank-level = <0>;
    lcd-rgb-bg-color = <0x00000000>;
    lcd-vh-delay-en = <0>;
    lcd-vh-delay-cycle = <0>;
    lcd-v-unit = <0>;
    lcd-alert-line = <30>;
    status = "disable";
    
    adt07016BR50: lcd-panel@1 { //for AJB RGB panel setting
        compatible = "sat,sat070cp50";
        panel-if = <0>; //0 for RGB, 1 for MIPI, 2 for MPU
        panel-rgb-seq = <1>; //0 for BGR, 1 for RGB
        panel-width = <1024>;
        panel-height = <600>;
        panel-pclk-div = <10>; //pixel clock = Peri_pll/(pclk_div+1)
        panel-thpw = <60>;
        panel-thb = <100>;
        panel-thf = <120>;
        panel-tvpw = <2>;
        panel-tvb = <21>;
        panel-tvf = <12>;
        panel-pclk-pol = <0>; //0:pos, 1:neg
        panel-hsync-pol = <1>;
        panel-vsync-pol = <1>;
        panel-vogate-pol = <0>;
        panel-bus-width = <3>; //0:8bits,1:16bits,2:18bits,3:24bits
        panel-sync-mode = <1>; 

        status = "disable";
    };
#if 0
    adt07029bm30: lcd-panel@9{ //for AJB 7.0 inch MIPI panel setting
            compatible = "adt,adt07029bm30-08";
            panel-if = <1>; //0 for RGB, 1 for MIPI, 2 for MPU
            panel-rgb-seq = <1>; //0 for BGR, 1 for RGB
            panel-width = <1024>;
            panel-height = <600>;
            panel-pclk-div = <8>; //pixel clock = Peri_pll/(pclk_div+1)
            panel-dsi-num-lane = <3>; //0-3: 1lane-4lane
            //0-3: data0-data3, 4: clk
            panel-dsi-txd0 = <0>;
            panel-dsi-txd1 = <1>;
            panel-dsi-txd2 = <4>;
            panel-dsi-txd3 = <2>;
            panel-dsi-txd4 = <3>;
            panel-dsi-noncontinuous-clk = <0>; //0:continuous,1:noncontinuous
            panel-dsi-t-pre = <1>; //t-pre, >=1
            panel-dsi-t-post = <1>; //t-post=tlpx+t-prepare+t-zero+t-pre, >=1
            panel-dsi-tx-gap = <1>; //ths-exit
            panel-dsi-autoinsert-eotp = <0>; //0:not insert,1:auto-insert
            panel-dsi-htx-to-count = <0xFFFFFF>; //high speed TX timeout count
            panel-dsi-lrx-to-count = <0xFFFFFF>; //Low power RX timeout count
            panel-dsi-bta-to-count = <0xFFFFFF>; //Bus turn around timeout count
            panel-dsi-t-wakeup = <0xc8>; //DPHY T-wakeup time
            panel-dsi-pix-fifo-send-level = <512>; //buffer send level <= 512
            //0-2:16-bit config 1-3; 3-4:18-bit config 1-2; 5:24-bit
            panel-dsi-if-color-coding = <0x05>;
            //0:16-bit;1:18-bit;2:18-bit loosely packed;3:24-bit
            panel-dsi-pix-format = <0x03>;
            panel-dsi-vsync-pol = <0>; //0:active low; 1:active high
            panel-dsi-hsync-pol = <0>; //0:active low; 1:active high
            //0:Non-burst mode with sync pulses;
            //1:Noe-burst mode with sync events;
            //2:Burst mode; 3:reserved
            panel-dsi-video-mode = <2>;
            panel-dsi-hfp = <40>; //H front porch blanking packet payload size in bytes
            panel-dsi-hbp = <20>; //H back porch blanking packet payload size in bytes
            panel-dsi-hsa = <20>; //H sync width blanking packet payload size in bytes
            panel-dsi-mult-pkts-en = <0>; //0: single packet;1: two packets
            panel-dsi-vbp = <8>; //V back porch lines
            panel-dsi-vfp = <8>; //V front porch lines
            panel-dsi-vsa = <4>;
            //0:blanking packets send during BLLP;1:LP mode used for BLLP
            panel-dsi-bllp-mode = <1>;
            panel-dsi-use-null-pkt-bllp = <0>; //0:blanking packet; 1:Null packet
            panel-dsi-vc = <0x00>; //Virtual channel
            panel-dsi-cmd-type = <0x0>; //0:send in LP mode, 1:send in HS mode
            panel-dsi-clk = <600>;
            panel-init-list =  //delay, type, data, parameters, end symbol
                            < 0x00 0x15 0x00 0x01 0xFFF
                              0x1E 0x15 0x00 0x00 0xFFF
                              0x00 0x15 0x8B 0x80 0xFFF
                              0x00 0x15 0x8B 0x80 0xFFF
                              0x00 0x15 0xFF 0x81 0xFFF
                              0x00 0x15 0x3C 0x82 0xFFF
                              0x00 0x15 0xFF 0x83 0xFFF
                              0x00 0x15 0xCA 0x84 0xFFF
                              0x00 0x15 0xAF 0x85 0xFFF
                              0x00 0x15 0xB5 0x86 0xFFF>;
        status = "disable";
    };
#endif	
	sat101at40i28y03:lcd-panel@14 { // for MIPI 4lane
			compatible = "sat,sat101at40i28y03";
			panel-if = <1>; //0 for RGB, 1 for MIPI, 2 for MPU
			panel-rgb-seq = <1>; //0 for BGR, 1 for RGB
			panel-width = <800>;
			panel-height = <1280>;
			panel-pclk-div = <8>; //pixel clock = Peri_pll/(pclk_div+1) <7>;<8>;
			panel-dsi-num-lane = <3>; //0-3: 1lane-4lane
			//0-3: data0-data3, 4: clk
			panel-dsi-txd0 = <0>;
			panel-dsi-txd1 = <1>;
			panel-dsi-txd2 = <4>;
			panel-dsi-txd3 = <2>;
			panel-dsi-txd4 = <3>;

			panel-dsi-noncontinuous-clk = <1>; //0:continuous,1:noncontinuous
			panel-dsi-t-pre = <1>; //t-pre, >=1
			panel-dsi-t-post = <1>; //t-post=tlpx+t-prepare+t-zero+t-pre, >=1
			panel-dsi-tx-gap = <1>; //ths-exit
			panel-dsi-autoinsert-eotp = <0>; //0:not insert,1:auto-insert
			panel-dsi-htx-to-count = <0xFFFFFF>; //high speed TX timeout count
			panel-dsi-lrx-to-count = <0xFFFFFF>; //Low power RX timeout count
			panel-dsi-bta-to-count = <0xFFFFFF>; //Bus turn around timeout count
			panel-dsi-t-wakeup = <0xc8>; //DPHY T-wakeup time
			panel-dsi-pix-fifo-send-level = <512>; //buffer send level <= 512
			//0-2:16-bit config 1-3; 3-4:18-bit config 1-2; 5:24-bit
			panel-dsi-if-color-coding = <0x05>;
			//0:16-bit;1:18-bit;2:18-bit loosely packed;3:24-bit
			panel-dsi-pix-format = <0x03>;
			panel-dsi-vsync-pol = <0>; //0:active low; 1:active high
			panel-dsi-hsync-pol = <0>; //0:active low; 1:active high
			//0:Non-burst mode with sync pulses;
			//1:Noe-burst mode with sync events;
			//2:Burst mode; 3:reserved
			panel-dsi-video-mode = <2>;
			panel-dsi-hfp = <32>;//<20>;<40>; //H front porch blanking packet payload size in bytes
			panel-dsi-hbp = <8>;//<20>;<40>; //H back porch blanking packet payload size in bytes
			panel-dsi-hsa = <8>;//<20>;<40>; //H sync width blanking packet payload size in bytes
			panel-dsi-mult-pkts-en = <0>; //0: single packet;1: two packets
			panel-dsi-vbp = <8>;//<8>;<8>; //V back porch lines
			panel-dsi-vfp = <30>;//<30>;<8>; //V front porch lines
			panel-dsi-vsa = <4>;//<4>;<4>;
			//0:blanking packets send during BLLP;1:LP mode used for BLLP
			panel-dsi-bllp-mode = <1>;
			panel-dsi-use-null-pkt-bllp = <0>; //0:blanking packet; 1:Null packet
			panel-dsi-vc = <0x00>; //Virtual channel
			panel-dsi-cmd-type = <0x0>; //0:send in LP mode, 1:send in HS mode
			panel-dsi-clk = <600>;//<410>;426

			// delay, type, data, parameters, end symbol
			panel-init-list = < 
				0x78 0x39 0xBD 0x00 0x00 0xFFF

				0x00 0x15 0xE0 0x00 0xFFF
				0x00 0x15 0xE1 0x93 0xFFF
				0x00 0x15 0xE2 0x65 0xFFF
				0x00 0x15 0xE3 0xF8 0xFFF
				0x00 0x15 0x80 0x03 0xFFF

				0x00 0x15 0xE0 0x01 0xFFF

				0x00 0x15 0x00 0x00 0xFFF
				0x00 0x15 0x01 0x26 0xFFF

				0x00 0x15 0x17 0x00 0xFFF
				0x00 0x15 0x18 0xD7 0xFFF //4.8v
				0x00 0x15 0x19 0x01 0xFFF //0.3v
				0x00 0x15 0x1A 0x00 0xFFF
				0x00 0x15 0x1B 0xD7 0xFFF //VGMN=0
				0x00 0x15 0x1C 0x01 0xFFF

				0x00 0x15 0x1F 0x70 0xFFF //VGH_REG=16.2V
				0x00 0x15 0x20 0x2D 0xFFF //VGL_REG=-12V
				0x00 0x15 0x21 0x2D 0xFFF //VGL_REG2=-12V
				0x00 0x15 0x22 0x7E 0xFFF
				0x00 0x15 0x24 0xFD 0xFFF

				0x00 0x15 0x37 0x19 0xFFF //SS=1,BGR=1

				0x00 0x15 0x35 0x28 0xFFF //SAP
				// Set RGBCYC
				0x00 0x15 0x38 0x05 0xFFF //JDT=101 zigzag inversion 
				0x00 0x15 0x39 0x08 0xFFF 
				0x00 0x15 0x3A 0x12 0xFFF 
				0x00 0x15 0x3C 0x7E 0xFFF //SET EQ3 for TE_H
				0x00 0x15 0x3D 0xFF 0xFFF //SET CHGEN_ON, modify 20140806
				0x00 0x15 0x3E 0xFF 0xFFF //SET CHGEN_OFF, modify 20140806
				0x00 0x15 0x3F 0x7F 0xFFF //SET CHGEN_OFF2, modify 20140806
				//  Set TCON
				0x00 0x15 0x40 0x06 0xFFF  //RSO 
				0x00 0x15 0x41 0xA0 0xFFF  //LN=640->1280 line
				0x00 0x15 0x43 0x1E 0xFFF  //VFP=0x1E 0x08
				0x00 0x15 0x44 0x0B 0xFFF  //VBP 0x0B 0x08

				//  Power Voltage
				0x00 0x15 0x55 0x02 0xFFF  // DCDCM=1111
				0x00 0x15 0x56 0x01 0xFFF
				0x00 0x15 0x57 0x6A 0xFFF
				0x00 0x15 0x58 0x09 0xFFF
				0x00 0x15 0x59 0x0A 0xFFF  // VCL = -2.5V
				0x00 0x15 0x5A 0x2E 0xFFF  // VGH =16V
				0x00 0x15 0x5B 0x1A 0xFFF  // VGL = -12V
				0x00 0x15 0x5C 0x15 0xFFF  // PUMP CLK
				//  Gamma
				0x00 0x15 0x5D 0x7F 0xFFF
				0x00 0x15 0x5E 0x5D 0xFFF
				0x00 0x15 0x5F 0x4B 0xFFF
				0x00 0x15 0x60 0x3E 0xFFF
				0x00 0x15 0x61 0x3A 0xFFF
				0x00 0x15 0x62 0x2B 0xFFF
				0x00 0x15 0x63 0x2F 0xFFF
				0x00 0x15 0x64 0x19 0xFFF
				0x00 0x15 0x65 0x32 0xFFF
				0x00 0x15 0x66 0x31 0xFFF
				0x00 0x15 0x67 0x31 0xFFF
				0x00 0x15 0x68 0x4F 0xFFF
				0x00 0x15 0x69 0x3E 0xFFF
				0x00 0x15 0x6A 0x47 0xFFF
				0x00 0x15 0x6B 0x36 0xFFF
				0x00 0x15 0x6C 0x31 0xFFF
				0x00 0x15 0x6D 0x24 0xFFF
				0x00 0x15 0x6E 0x12 0xFFF
				0x00 0x15 0x6F 0x02 0xFFF
				0x00 0x15 0x70 0x7F 0xFFF
				0x00 0x15 0x71 0x5D 0xFFF
				0x00 0x15 0x72 0x4B 0xFFF
				0x00 0x15 0x73 0x3E 0xFFF
				0x00 0x15 0x74 0x3A 0xFFF
				0x00 0x15 0x75 0x2B 0xFFF
				0x00 0x15 0x76 0x2F 0xFFF
				0x00 0x15 0x77 0x19 0xFFF
				0x00 0x15 0x78 0x32 0xFFF
				0x00 0x15 0x79 0x31 0xFFF
				0x00 0x15 0x7A 0x31 0xFFF
				0x00 0x15 0x7B 0x4F 0xFFF
				0x00 0x15 0x7C 0x3E 0xFFF
				0x00 0x15 0x7D 0x47 0xFFF
				0x00 0x15 0x7E 0x36 0xFFF
				0x00 0x15 0x7F 0x31 0xFFF
				0x00 0x15 0x80 0x24 0xFFF
				0x00 0x15 0x81 0x12 0xFFF
				0x00 0x15 0x82 0x02 0xFFF
				// page2
				0x00 0x15 0xE0 0x02 0xFFF
				// GIP_L PIN mapping
				0x00 0x15 0x00 0x52 0xFFF
				0x00 0x15 0x01 0x55 0xFFF
				0x00 0x15 0x02 0x55 0xFFF
				0x00 0x15 0x03 0x50 0xFFF
				0x00 0x15 0x04 0x77 0xFFF
				0x00 0x15 0x05 0x57 0xFFF
				0x00 0x15 0x06 0x55 0xFFF
				0x00 0x15 0x07 0x4E 0xFFF
				0x00 0x15 0x08 0x4C 0xFFF
				0x00 0x15 0x09 0x5F 0xFFF
				0x00 0x15 0x0A 0x4A 0xFFF
				0x00 0x15 0x0B 0x48 0xFFF
				0x00 0x15 0x0C 0x55 0xFFF
				0x00 0x15 0x0D 0x46 0xFFF
				0x00 0x15 0x0E 0x44 0xFFF
				0x00 0x15 0x0F 0x40 0xFFF
				0x00 0x15 0x10 0x55 0xFFF
				0x00 0x15 0x11 0x55 0xFFF
				0x00 0x15 0x12 0x55 0xFFF
				0x00 0x15 0x13 0x55 0xFFF
				0x00 0x15 0x14 0x55 0xFFF
				0x00 0x15 0x15 0x55 0xFFF
				// GIP_R PIN mapping
				0x00 0x15 0x16 0x53 0xFFF
				0x00 0x15 0x17 0x55 0xFFF
				0x00 0x15 0x18 0x55 0xFFF
				0x00 0x15 0x19 0x51 0xFFF
				0x00 0x15 0x1A 0x77 0xFFF
				0x00 0x15 0x1B 0x57 0xFFF
				0x00 0x15 0x1C 0x55 0xFFF
				0x00 0x15 0x1D 0x4F 0xFFF
				0x00 0x15 0x1E 0x4D 0xFFF
				0x00 0x15 0x1F 0x5F 0xFFF
				0x00 0x15 0x20 0x4B 0xFFF
				0x00 0x15 0x21 0x49 0xFFF
				0x00 0x15 0x22 0x55 0xFFF
				0x00 0x15 0x23 0x47 0xFFF
				0x00 0x15 0x24 0x45 0xFFF
				0x00 0x15 0x25 0x41 0xFFF
				0x00 0x15 0x26 0x55 0xFFF
				0x00 0x15 0x27 0x55 0xFFF
				0x00 0x15 0x28 0x55 0xFFF
				0x00 0x15 0x29 0x55 0xFFF
				0x00 0x15 0x2A 0x55 0xFFF
				0x00 0x15 0x2B 0x55 0xFFF
				//  GIP_L_GS PIN mapping
				0x00 0x15 0x2C 0x13 0xFFF
				0x00 0x15 0x2D 0x15 0xFFF
				0x00 0x15 0x2E 0x15 0xFFF
				0x00 0x15 0x2F 0x01 0xFFF
				0x00 0x15 0x30 0x37 0xFFF
				0x00 0x15 0x31 0x17 0xFFF
				0x00 0x15 0x32 0x15 0xFFF
				0x00 0x15 0x33 0x0D 0xFFF
				0x00 0x15 0x34 0x0F 0xFFF
				0x00 0x15 0x35 0x15 0xFFF
				0x00 0x15 0x36 0x05 0xFFF
				0x00 0x15 0x37 0x07 0xFFF
				0x00 0x15 0x38 0x15 0xFFF
				0x00 0x15 0x39 0x09 0xFFF
				0x00 0x15 0x3A 0x0B 0xFFF
				0x00 0x15 0x3B 0x11 0xFFF
				0x00 0x15 0x3C 0x15 0xFFF
				0x00 0x15 0x3D 0x15 0xFFF
				0x00 0x15 0x3E 0x15 0xFFF
				0x00 0x15 0x3F 0x15 0xFFF
				0x00 0x15 0x40 0x15 0xFFF
				0x00 0x15 0x41 0x15 0xFFF

				//  GIP_R_GS PIN mapping
				0x00 0x15 0x42 0x12 0xFFF
				0x00 0x15 0x43 0x15 0xFFF
				0x00 0x15 0x44 0x15 0xFFF
				0x00 0x15 0x45 0x00 0xFFF
				0x00 0x15 0x46 0x37 0xFFF
				0x00 0x15 0x47 0x17 0xFFF
				0x00 0x15 0x48 0x15 0xFFF
				0x00 0x15 0x49 0x0C 0xFFF
				0x00 0x15 0x4A 0x0E 0xFFF
				0x00 0x15 0x4B 0x15 0xFFF
				0x00 0x15 0x4C 0x04 0xFFF
				0x00 0x15 0x4D 0x06 0xFFF
				0x00 0x15 0x4E 0x15 0xFFF
				0x00 0x15 0x4F 0x08 0xFFF
				0x00 0x15 0x50 0x0A 0xFFF
				0x00 0x15 0x51 0x10 0xFFF
				0x00 0x15 0x52 0x15 0xFFF
				0x00 0x15 0x53 0x15 0xFFF
				0x00 0x15 0x54 0x15 0xFFF
				0x00 0x15 0x55 0x15 0xFFF
				0x00 0x15 0x56 0x15 0xFFF
				0x00 0x15 0x57 0x15 0xFFF
				// GIP Timing
				0x00 0x15 0x58 0x40 0xFFF
				0x00 0x15 0x5B 0x10 0xFFF
				0x00 0x15 0x5C 0x06 0xFFF
				0x00 0x15 0x5D 0x40 0xFFF
				0x00 0x15 0x5E 0x00 0xFFF
				0x00 0x15 0x5F 0x00 0xFFF
				0x00 0x15 0x60 0x40 0xFFF
				0x00 0x15 0x61 0x03 0xFFF
				0x00 0x15 0x62 0x04 0xFFF
				0x00 0x15 0x63 0x6C 0xFFF
				0x00 0x15 0x64 0x6C 0xFFF
				0x00 0x15 0x65 0x75 0xFFF
				0x00 0x15 0x66 0x08 0xFFF
				0x00 0x15 0x67 0xB4 0xFFF
				0x00 0x15 0x68 0x08 0xFFF
				0x00 0x15 0x69 0x6C 0xFFF
				0x00 0x15 0x6A 0x6C 0xFFF
				0x00 0x15 0x6B 0x0C 0xFFF
				0x00 0x15 0x6D 0x00 0xFFF
				0x00 0x15 0x6E 0x00 0xFFF
				0x00 0x15 0x6F 0x88 0xFFF
				0x00 0x15 0x75 0xBB 0xFFF
				0x00 0x15 0x76 0x00 0xFFF
				0x00 0x15 0x77 0x05 0xFFF
				0x00 0x15 0x78 0x2A 0xFFF
				//  page4
				0x00 0x15 0xE0 0x04 0xFFF
				0x00 0x15 0x09 0x11 0xFFF
				0x00 0x15 0x0E 0x48 0xFFF
				0x00 0x15 0x2D 0x03 0xFFF

				//  page0
				0x00 0x15 0xE0 0x00 0xFFF
				0x00 0x15 0xE6 0x02 0xFFF
				0x00 0x15 0xE7 0x06 0xFFF

				0x78 0x05 0x11 0x00 0xFFF

				0x05 0x05 0x29 0x00 0xFFF

				0x00 0x15 0x35 0x00 0xFFF
				0x00 0x15 0xE0 0x00 0xFFF>;

			status = "disable";
		};
	
};
