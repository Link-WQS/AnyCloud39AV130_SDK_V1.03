## os/uboot/drivers/clk/anyka/Kconfig
```kconfig
config CLK_ANYKA_37E
	bool "Enable clock support on Anycloud37E"
	help
	  Enable clock support for Anycloud37E base on SUN4.

config CLK_ANYKA_3918AV100
	bool "Enable clock support on Anycloud3918av100"
	help
	  Enable clock support for Anycloud3918av100 base on h322.

config CLK_ANYKA_3918AV130
	bool "Enable clock support on Anycloud3918av130"
	help
	  Enable clock support for Anycloud3918av130 base on h322LS.

config CLK_ANYKA_KM01A
	bool "Enable clock support on Anycloudkm01a"
	help
	  Enable clock support for Anycloudkm01a base on h322.
config CLK_ANYKA_3918EV300L
	bool "Enable clock support on Anycloud3918ev300l"
	help
	  Enable clock support for Anycloud3918ev300l base on h322L.

config CLK_ANYKA_37D
	bool "Enable clock support on Anycloud37D"
	help
	  Enable clock support for AnyCloud37D base on h3d.

config CLK_ANYKA_39EV33X
	bool "Enable clock support on Anycloud39ev33x"
	help
	  Enable clock support for Anycloud39ev33x base on h3b.

config CLK_ANYKA_39EV200
	bool "Enable clock support on Anycloud39ev200"
	help
	  Enable clock support for Anycloud39ev200 base on h240.
```

## os/uboot/drivers/gpio/anyka/Kconfig
```kconfig
if ARCH_AK37E

config AK37E_GPIO
	bool "AK37E PIO GPIO driver"
	depends on DM_GPIO
	default y
	help
		say ye to select ak37e gpio.
endif

if ARCH_AK3918AV100

config AK3918AV100_GPIO
	bool "AK3918AV100 PIO GPIO driver"
	depends on DM_GPIO
	default y
	help
		say ye to select ak3918av100 gpio.
endif

if ARCH_AK3918EV300L

config AK3918EV300L_GPIO
	bool "AK3918EV300L PIO GPIO driver"
	depends on DM_GPIO
	default y
	help
		say ye to select ak3918ev300l gpio.
endif

if ARCH_AK37D

config AK37D_GPIO
	bool "AK37D PIO GPIO driver"
	depends on DM_GPIO
	default y
	help
		say ye to select ak37d gpio.
endif


if ARCH_AK39EV33X

config AK39EV33X_GPIO
	bool "AK39EV33X PIO GPIO driver"
	depends on DM_GPIO
	default y
	help
		say ye to select ak39ev33x gpio.
endif

if ARCH_AK39EV200

config AK39EV200_GPIO
	bool "AK39EV200 PIO GPIO driver"
	depends on DM_GPIO
	default y
	help
		say ye to select ak39ev200 gpio.
endif

if ARCH_AK3918AV130

config AK3918AV130_GPIO
	bool "AK3918AV130 PIO GPIO driver"
	depends on DM_GPIO
	default y
	help
		say ye to select ak3918av130 gpio.
endif
```

## os/uboot/drivers/pinctrl/anyka/Kconfig
```kconfig
if ARCH_AK37E

config PINCTRL_AK37E
	bool "ak37e pin control drivers"
	depends on ARCH_AK37E&& PINCTRL_GENERIC
	default y
	help
	  Enable support pin control functions for ak37e.

endif

if ARCH_AK37D

config PINCTRL_AK37D
	bool "ak37d pin control drivers"
	depends on ARCH_AK37D&& PINCTRL_GENERIC
	default y
	help
	  Enable support pin control functions for ak37d.

endif

if ARCH_AK39EV33X

config PINCTRL_AK39EV33X
	bool "ak39ev33x pin control drivers"
	depends on ARCH_AK39EV33X&& PINCTRL_GENERIC
	default y
	help
	  Enable support pin control functions for ak39ev33x.

endif

if ARCH_AK3918AV100

config PINCTRL_AK3918AV100
	bool "ak3918av100 pin control drivers"
	depends on ARCH_AK3918AV100&& PINCTRL_GENERIC
	default y
	help
	  Enable support pin control functions for ak3918av100.

endif

if ARCH_AK3918AV130

config PINCTRL_AK3918AV130
	bool "ak3918av130 pin control drivers"
	depends on ARCH_AK3918AV130&& PINCTRL_GENERIC
	default y
	help
	  Enable support pin control functions for ak3918av130.

endif

if ARCH_KM01A

config PINCTRL_KM01A
	bool "km01a pin control drivers"
	depends on ARCH_KM01A&& PINCTRL_GENERIC
	default y
	help
	  Enable support pin control functions for km01a.

endif

if ARCH_AK3918EV300L

config PINCTRL_AK3918EV300L
	bool "ak3918ev300l pin control drivers"
	depends on ARCH_AK3918EV300L&& PINCTRL_GENERIC
	default y
	help
	  Enable support pin control functions for ak3918ev300l.

endif

if ARCH_AK39EV200

config PINCTRL_AK39EV200
	bool "ak39ev200 pin control drivers"
	depends on ARCH_AK39EV200&& PINCTRL_GENERIC
	default y
	help
	  Enable support pin control functions for ak39ev200.

endif
```

## tools/secureboot/cloudOS.its
```
/*
 * Simple U-Boot uImage source file containing a single kernel and FDT blob
 */

/dts-v1/;

/ {
	description = "Simple image with single Linux kernel and FDT blob";
	#address-cells = <1>;

	images {
		fdt {
			description = "Flattened Device Tree blob";
			data = /incbin/("../burntool/cloudOS.dtb");
			type = "flat_dt";
			arch = "arm";
			compression = "none";
			signature {
				algo = "sha256,rsa2048";
				key-name-hint = "dev";
			};
		};
	};

	configurations {
		default = "conf";
		conf {
			description = "Boot Linux kernel with FDT blob";
			fdt = "fdt";
		};
	};
};
```

## tools/secureboot/root.its
```
/*
 * Simple U-Boot uImage source file containing a single kernel and FDT blob
 */

/dts-v1/;

/ {
	description = "Simple image with single Linux kernel and FDT blob";
	#address-cells = <1>;

	images {
		rootfs {
			description = "anyka rootfs";
			data = /incbin/("../burntool/root.sqsh4");
			type = "filesystem";
			arch = "arm";
			compression = "none";
			signature {
				algo = "sha256,rsa2048";
				key-name-hint = "dev";
			};
		};
	};

	configurations {
		default = "conf";
		conf {
			description = "Boot Linux kernel with FDT blob";
			filesystem = "rootfs";
		};
	};
};
```

## tools/secureboot/uImage.its
```
/*
 * Simple U-Boot uImage source file containing a single kernel and FDT blob
 */

/dts-v1/;

/ {
	description = "Simple image with single Linux kernel and FDT blob";
	#address-cells = <1>;

	images {
		kernel {
			description = "anyka Linux kernel";
			data = /incbin/("../burntool/uImage");
			type = "kernel";
			arch = "arm";
			os = "linux";
			compression = "none";
			load = <0x80008000>;
			entry = <0x80008040>;
			signature {
				algo = "sha256,rsa2048";
				key-name-hint = "dev";
			};
		};
	};

	configurations {
		default = "conf";
		conf {
			description = "Boot Linux kernel with FDT blob";
			kernel = "kernel";
		};
	};
};
```
