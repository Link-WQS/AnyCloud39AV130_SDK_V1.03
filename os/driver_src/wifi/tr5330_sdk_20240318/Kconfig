## os/driver_src/wifi/tr5330_sdk_20240318/Kconfig
```kconfig
mainmenu "$(WSCFG_MENUCONFIG_TITLE)"

menu "build"
rsource "build/Kconfig"
endmenu

menu "MFG"
orsource "build/config/Kconfig"
endmenu

menu "WiFi"
rsource "driver/wifi/Kconfig"
endmenu

menu "Platform"
rsource "driver/platform/Kconfig"
endmenu

menu "BLE"
config WSCFG_BLE_COMPILE_BY_DEFAULT
	bool "Compile ble by default"
	default y
	--help--
		Turn on this option, and execute "make" or "make all" will compile ble

rsource "driver/bsle/ble_driver/Kconfig"
endmenu

menu "SLE"
config WSCFG_SLE_COMPILE_BY_DEFAULT
	bool "Compile sle by default"
	default y
	--help--
		Turn on this option, and execute "make" or "make all" will compile sle

rsource "driver/bsle/sle_driver/Kconfig"
endmenu
```

## os/driver_src/wifi/tr5330_sdk_20240318/application/sample/bt/Kconfig
```kconfig
#===============================================================================
# @brief    Kconfig file.
# Copyright (c) @CompanyNameMagicTag 2023-2023. All rights reserved.
#===============================================================================
config ENABLE_BT_SAMPLE
    bool
    prompt "Enable the Sample of BT."
    default n
    depends on SAMPLE_ENABLE
    help
        This option means enable the sample of BT.
```

## os/driver_src/wifi/tr5330_sdk_20240318/build/Kconfig
```kconfig
comment "Configure the compilation environment"

# compiler
choice
	prompt "compiler"
	default WSCFG_USING_GCC

config WSCFG_USING_GCC
	bool "using gcc"

config WSCFG_USING_LLVM_CLANG
	bool "using llvm clang"

endchoice

config WSCFG_CROSS_COMPILE
	string "Configure the compilation toolchain"
	--help--
		Configure the compilation toolchain, similar to the kernel style configuration

if WSCFG_USING_LLVM_CLANG
config WSCFG_CLANG_PATH
	string "clang excecutable binary directory path"
    --help--
        specify the clang excecutable binary path. using "/opt/clang/bin" for "/opt/clang/bin/clang" etc.
endif

config WSCFG_KERNEL_DIR
	string "Configure the kernel dir"
	--help--
		Configure the kernel directory for compiling the driver

config WSCFG_EXTRA_CFLAGS
	string "extra cflags for kernel module build"
    --help--
        specify the extra cflags for kernel module build. some host may need "-Wno-error=missing-braces" as example.

config WSCFG_EXTRA_PARAMS
	string "extra compilation params for kernel module build"
    --help--
        specify the extra compilation params for kernel module build. some host may need "LLVM=1 LLVM_IAS=1" as example.

# arch
choice
	prompt "Arch"
	default WSCFG_ARCH_ARM

config WSCFG_ARCH_ARM
	bool "arm"

config WSCFG_ARCH_CUSTOM
	bool "custom"

if WSCFG_ARCH_CUSTOM
config WSCFG_ARCH_NAME
	string "Configure the arch name"
endif

endchoice

if !WSCFG_ARCH_CUSTOM
config WSCFG_ARCH_NAME
	string
	default "arm" if WSCFG_ARCH_ARM
endif

# board
config BOARD_ASIC
	bool
	default y

config BOARD_FPGA_WIFI
	bool
	default y if BOARD_FPGA

config BOARD_ASIC_WIFI
	bool
	default y if BOARD_ASIC


# bus
choice
	prompt "Bus type"
	default WSCFG_BUS_SDIO

config WSCFG_BUS_SDIO
	bool "sdio"

config WSCFG_BUS_USB
	bool "usb"

config WSCFG_BUS_UART
	bool "uart"

endchoice

# os
config WSCFG_LINUX
	bool
	default y


# config OS macro
config _PRE_OS_VERSION_LINUX
	int
	default 0

config _PRE_OS_VERSION_WIN32
	int
	default 1

config _PRE_OS_VERSION_WINDOWS
	int
	default 2

config _PRE_OS_VERSION_RAW
	int
	default 3

config _PRE_OS_VERSION_HiRTOS
	int
	default 4

config _PRE_OS_VERSION_WIN32_RAW
	int
	default 5

config _PRE_OS_VERSION_LITEOS
	int
	default 6

config _PRE_OS_VERSION_ANDROID
	int
	default 7

config _PRE_OS_VERSION
	int
	default _PRE_OS_VERSION_LINUX if WSCFG_LINUX
	default _PRE_OS_VERSION_WIN32 if WSCFG_WIN32
	default _PRE_OS_VERSION_WINDOWS if WSCFG_WINDOWS
	default _PRE_OS_VERSION_RAW if WSCFG_RAW
	default _PRE_OS_VERSION_HiRTOS if WSCFG_HiRTOS
	default _PRE_OS_VERSION_WIN32_RAW if WSCFG_WIN32_RAW
	default _PRE_OS_VERSION_LITEOS if WSCFG_LITEOS
	default _PRE_OS_VERSION_ANDROID if WSCFG_ANDROID
```

## os/driver_src/wifi/tr5330_sdk_20240318/build/config/Kconfig
```kconfig
config WSCFG_MFG_TEST
	bool "Enable MFG TEST"
	default y
	select WIFI_ALWAYS_TX
	depends on WSCFG_LINUX
```

## os/driver_src/wifi/tr5330_sdk_20240318/driver/bsle/ble_driver/Kconfig
```kconfig
#===============================================================================
# @brief    Kconfig file.
# Copyright (c) @CompanyNameMagicTag 2023-2023. All rights reserved.
#===============================================================================
menu "Configure the ble ini file"

config CONFIG_INI_BLE_DISABLE_LL_PRIVACY
    bool "ble disable ll privacy"
    default n

config CONFIG_INI_BLE_TV_RC_SCAN_INTERVAL
    int "ble tv rc scan interval"
    default 480
    range 4 65535
    --help--
        ble tv rc scan interval, default 480 slots which is 300 ms (value range 4-65535)

config CONFIG_INI_BLE_TV_RC_SCAN_WINDOW
    int "ble tv rc scan window"
    default 48
    range 4 65535
    --help--
        ble tv rc scan window, default 48 slots which is 30 ms (value range 4-65535)

config CONFIG_INI_BSLE_FRONT_SWITCH
    bool "bsle front switch"
    default n

endmenu

config CONFIG_BLE_MAC_FORK
    bool "is ble mac forked"
    default y
```

## os/driver_src/wifi/tr5330_sdk_20240318/driver/platform/Kconfig
```kconfig
config _PRE_PLAT_SHA256SUM_CHECK
	bool "Enable upgrade package verification"
	default y
	--help--
		Verify the integrity of the upgrade package of the device bin

config WSCFG_ONEIMAGE
	bool "Enable oneimage"
	default n
	--help--
		oneimage is used to resolve number conflicts

menuconfig WSCFG_PLAT_VARIABLE_FEATRUE
	bool "Enable enhanced features"
	default y
	--help--
		Enhanced feature master switch on platform side.
		Enhanced features are features that can be turned on and off at any time.
		Generally, turning on and off these features will not cause major functional problems

if WSCFG_PLAT_VARIABLE_FEATRUE

	menuconfig WSCFG_PLAT_DIAG_LOG_OUT
		bool "Enable diag log out"
		default y
		--help--
			Platform log output master switch

	if WSCFG_PLAT_DIAG_LOG_OUT
		config CONFIG_DIAG_SUPPORT_SOCKET
			bool "Enable diag socket support"
			default y

		config CONFIG_DIAG_SUPPORT_UART
			bool "Enable diag uart support"
			default y

		config CONFIG_DIAG_SUPPORT_LOCAL_LOG
			bool "Enable diag local log support"
			default y

		config CONFIG_DFX_SUPPORT_SHELL_PROC
			bool "Enable dfx shell proc"
			default y
			depends on CONFIG_DIAG_SUPPORT_SOCKET
	endif

	config CONFIG_PLAT_SUPPORT_DFR
		bool "Enable Plat DFR"
		default y
		depends on WSCFG_LINUX

	config CONFIG_PLAT_DFR_OUTPUT_PATH
		string "Dfr Output Path, The Path Must Exist, Example : '/etc/tr5330' "
		default "/etc/tr5330"
		depends on CONFIG_PLAT_SUPPORT_DFR
		--help--
			dfr output path, the path must exist, example : '/etc/tr5330'

	config CONFIG_HCC_SUPPORT_TEST
		bool "Enable Plat Hcc Test"
		default y

	config CONFIG_HCC_ERROR_PRINT
		bool "Enable Plat Hcc Error Print"
		default y
endif

config _PRE_PLAT_HCC_SDIO
	bool "Enable hcc on SDIO"
	default y
	depends on WSCFG_BUS_SDIO
	--help--
		Enable hcc on SDIO

config _PRE_PLAT_HCC_USB
	bool "Enable hcc on USB"
	default y
	depends on WSCFG_BUS_USB
	--help--
		Enable hcc on USB

config _PRE_PLAT_HCC_UART
	bool "Enable hcc on UART"
	default n
	depends on WSCFG_BUS_UART
	--help--
		Enable hcc on UART

config CONFIG_PLAT_UART_IO_CFG
	bool "Enable cfg on uart io"
	default n
	depends on _PRE_PLAT_HCC_UART
	--help--
		Enable CFG on UART_IO

config CONFIG_HCC_USB_ZLP_FIXME
	bool "HCC fixme URB_ZERO_PACKET problem"
	default n
	depends on _PRE_PLAT_HCC_USB
	--help--
                hcc fixme URB_ZERO_PACKET problem

config CONFIG_TTY_DEV_NAME
	string "Configure the download tty device name"
	default "ttyAMA1"
	depends on WSCFG_BUS_UART

config BT_EM_BUFFER_CALI_SUPPORT
	bool "BT cali use EM_BUFFER if Enable"
	default n
	--help--
		The memory used by BT cali can be CPURAM or EM_BUFFER, Enable to choose EM_BUFFER.

config _PRE_PLAT_SLP_UART_FORWARD
	bool "Enable UART forward"
	default n
	--help--
		Need device side support

config CONFIG_DFX_SUPPORT_SYSFS
	bool "Enable DFX support sysfs"
	default y

config CONFIG_SDIO_RESCAN
	bool "Enable SDIO RESCAN"
	default n
	depends on WSCFG_BUS_SDIO

menu "Configure the loading path of files such as firmware"

config CONFIG_FIRMWARE_BIN_PATH
	string "Configure fw bin loading path"
	default "/etc/tr5330/tr5330.bin" if WSCFG_LINUX
	default "/jffs0/tr5330.bin" if WSCFG_LITEOS

config CONFIG_FIRMWARE_WIFICALI_PATH
	string "Configure wifi cali bin loading path"
	default "/etc/tr5330/wifi_cali.bin" if WSCFG_LINUX
	default "/jffs0/wifi_cali.bin" if WSCFG_LITEOS

config CONFIG_FIRMWARE_BSLECALI_PATH
	string "Configure bsle cali bin loading path"
	default "/etc/tr5330/btc_cali.bin" if WSCFG_LINUX
	default "/jffs0/btc_cali.bin" if WSCFG_LITEOS

config CONFIG_FIRMWARE_WOW_PATH
	string "Configure wow bin loading path"
	default "/etc/tr5330/wow.bin" if WSCFG_LINUX
	default "/jffs0/wow.bin" if WSCFG_LITEOS

config CONFIG_INI_FILE_PATH
	string "Configure ini file loading path"
	default "/etc/tr5330_cfg.ini"

endmenu

config CONFIG_ANDROID_FEATURE
	bool "Configure Android System"
	default n

config CONTROLLER_CUSTOMIZATION
	bool "Enable controller customization"
	default n
```
