## os/uboot/configs/ak3918av100_nand_spl_defconfig
```kconfig
CONFIG_ANYKA=y
CONFIG_3918AV100_CODE=y
CONFIG_ARM=y
CONFIG_SYS_THUMB_BUILD=y
CONFIG_ARCH_AK3918AV100=y
CONFIG_SYS_TEXT_BASE=0x80dff800
CONFIG_NR_DRAM_BANKS=1
CONFIG_PRE_CON_BUF_ADDR=0x80000000
CONFIG_PRE_CON_BUF_SZ=4096
CONFIG_BOOTSTAGE_STASH_ADDR=0
CONFIG_IDENT_STRING=""
# CONFIG_CMD_DEKBLOB is not set
# CONFIG_CMD_HDMIDETECT is not set
CONFIG_AK3918AV100=y
CONFIG_TARGET_ANYCLOUD_AK3918AV100=y
CONFIG_BOOTDELAY=1
CONFIG_SYS_MALLOC_CLEAR_ON_INIT=y

#
# Boot images
#
#CONFIG_FIT is not set
CONFIG_FIT_EXTERNAL_OFFSET=0x0
CONFIG_FIT_ENABLE_SHA256_SUPPORT is not set
# CONFIG_FIT_SIGNATURE is not set
# CONFIG_FIT_VERBOSE is not set
# CONFIG_FIT_BEST_MATCH is not set

#
# Hashing Support
#
CONFIG_SHA1 is not set
CONFIG_SHA256 is not set
# CONFIG_SHA_HW_ACCEL is not set
CONFIG_MD5 is not set

#
# Console
#
# CONFIG_CONSOLE_RECORD is not set
# CONFIG_DISABLE_CONSOLE is not set
# CONFIG_LOGLEVEL=4  is not set
# CONFIG_SPL_LOGLEVEL=4  is not set
# CONFIG_TPL_LOGLEVEL=4 is not set
# CONFIG_SILENT_CONSOLE is not set
CONFIG_PRE_CONSOLE_BUFFER=y
# CONFIG_CONSOLE_MUX is not set
# CONFIG_SYS_CONSOLE_IS_IN_ENV is not set
# CONFIG_SYS_CONSOLE_OVERWRITE_ROUTINE is not set
# CONFIG_SYS_CONSOLE_ENV_OVERWRITE is not set
# CONFIG_SYS_CONSOLE_INFO_QUIET is not set
# CONFIG_SYS_STDIO_DEREGISTER is not set
#CONFIG_DEFAULT_FDT_FILE="imx25-pdk.dtb" is not set
#
# Command line interface
#
CONFIG_CMDLINE=y
CONFIG_HUSH_PARSER=y
CONFIG_CMDLINE_EDITING=y
CONFIG_AUTO_COMPLETE=y
CONFIG_SYS_LONGHELP=y
CONFIG_SYS_PROMPT="=> "
CONFIG_SYS_XTRACE="y"
#

# Boot commands
#
# CONFIG_CMD_BOOTD is not set
CONFIG_CMD_BOOTM=y
# CONFIG_CMD_BOOTZ is not set
# CONFIG_EFI_LOADER is not set
# CONFIG_CMD_BOOTEFI is not set
# CONFIG_CMD_BOOTEFI_HELLO_COMPILE is not set
# CONFIG_CMD_BOOTEFI_HELLO is not set
# CONFIG_CMD_BOOTEFI_SELFTEST is not set
# CONFIG_CMD_BOOTMENU is not set
# CONFIG_CMD_DTIMG is not set
# CONFIG_CMD_ELF is not set
# CONFIG_CMD_FDT is not set
# CONFIG_CMD_EDITENV is not set
CONFIG_CMD_GO=y
CONFIG_CMD_RUN=y
# CONFIG_CMD_IMI is not set
# CONFIG_CMD_IMLS is not set
# CONFIG_CMD_XIMG is not set
# CONFIG_CMD_FITUPD is not set
# CONFIG_CMD_THOR_DOWNLOAD is not set
# CONFIG_CMD_ZBOOT is not set
# CONFIG_CMD_FLASH is not set
# CONFIG_CMD_I2C is not set
# CONFIG_CMD_LOADS is not set
CONFIG_CMD_MMC=y
# CONFIG_CMD_PINMUX is not set
CONFIG_CMD_FAT=y
# CONFIG_CMD_ECHO is not set
# CONFIG_CMD_ITEST is not set
# CONFIG_CMD_SOURCE is not set
# CONFIG_CMD_SETEXPR is not set
# CONFIG_CMD_DHCP=y
# CONFIG_BOOTP_BOOTPATH is not set
# CONFIG_BOOTP_DNS is not set
# CONFIG_BOOTP_GATEWAY is not set
# CONFIG_BOOTP_HOSTNAME is not set
# CONFIG_BOOTP_SUBNETMASK is not set
# CONFIG_NET_TFTP_VARS is not set
# CONFIG_CMD_NFS is not set
# CONFIG_CMD_MII is not set
CONFIG_CMD_PING=y
CONFIG_CMD_CACHE=y
# CONFIG_CMD_MISC is not set
CONFIG_CMD_FS_GENERIC=y
#CONFIG_DOS_PARTITION is not set
CONFIG_SUPPORT_OF_CONTROL=y
CONFIG_DTC=y
#
# Device Tree Control
#
CONFIG_OF_CONTROL=y
# CONFIG_OF_EMBED is not set

CONFIG_MII=y
# CONFIG_FS_EXT4 is not set
CONFIG_FS_FAT=y
CONFIG_OF_LIBFDT=y
CONFIG_ENV_IS_IN_NAND=y
#
#
# Generic Driver Options
#
CONFIG_DM=y
#CONFIG_DM_WARN is not set

CONFIG_DM_DEVICE_REMOVE=y
CONFIG_DM_STDIO=y
CONFIG_DM_SEQ_ALIAS=y

#CONFIG_SIMPLE_BUS is not set

#CONFIG_DM_DEV_READ_INLINE is not set

# MMC Host controller Support
#
CONFIG_MMC=y
CONFIG_MMC_WRITE=y
CONFIG_DM_MMC=y
# CONFIG_MMC_QUIRKS is not set
# CONFIG_MMC_HW_PARTITIONING is not set
# CONFIG_MMC_VERBOSE is not set
CONFIG_MMC_ANYKA=y

# CONFIG_MTD_NOR_FLASH is not set
CONFIG_DM_SPI_NAND=y
CONFIG_DM_SPI_FLASH=y

CONFIG_PHYLIB=y
CONFIG_DM_ETH=y
CONFIG_AK_ETH=y
CONFIG_PHY_SR8201F=y
CONFIG_PHY_JL1101=y
CONFIG_PHY_SZ18201=y

#
# Pin controllers
#
CONFIG_PINCTRL=y
CONFIG_PINCTRL_FULL=y
CONFIG_PINCTRL_GENERIC=y
CONFIG_PINMUX=y
CONFIG_PINCONF=y
CONFIG_PINCTRL_AK3918AV100=y
# CONFIG_PINCTRL_AT91 is not set
# CONFIG_PINCTRL_AT91PIO4 is not set
# CONFIG_PINCTRL_ROCKCHIP_RV1108 is not set
# CONFIG_PINCTRL_SINGLE is not set
# CONFIG_PINCTRL_STM32 is not set
# CONFIG_PINCTRL_STMFX is not set
#
# Serial drivers
#
CONFIG_BAUDRATE=115200
CONFIG_REQUIRE_SERIAL_CONSOLE=y
CONFIG_SPECIFY_CONSOLE_INDEX=y
CONFIG_SERIAL_PRESENT=y
CONFIG_CONS_INDEX=1
CONFIG_DM_SERIAL=y
CONFIG_AK_SERIAL=y
CONFIG_SPI=y
CONFIG_AK_SPI=y
CONFIG_SPI_XFER_DMA=y
CONFIG_CMD_SF=y
CONFIG_DM_GPIO=y
CONFIG_AK3918AV100_GPIO=y
CONFIG_MTD=y
CONFIG_DM_SPI=y
CONFIG_SF_DEFAULT_SPEED=80000000
CONFIG_SF_DEFAULT_MODE=0x3

CONFIG_CMD_NAND=y
CONFIG_MTD_SPI_NAND=y

#
# Clock framework
#
CONFIG_CLK=y
CONFIG_CLK_CCF=y
CONFIG_CLK_ANYKA_3918AV100=y

#
# mtdparts
#
CONFIG_CMD_MTDPARTS=y

#
# Graphics support
#
CONFIG_DM_VIDEO=n

CONFIG_VIDEO_BPP8=y
CONFIG_VIDEO_BPP16=y
CONFIG_VIDEO_BPP32=y

CONFIG_ANYKA_FB=y

#
# imgae LZMA(for sky platform)
#
CONFIG_LZMA=y

#
# autoboot key enter uboot cmd line
#
#CONFIG_AUTOBOOT_KEYED is not set
CONFIG_AUTOBOOT_DELAY_STR="123"
CONFIG_AUTOBOOT_STOP_STR="456"
# CONFIG_REGEX is not set
# CONFIG_GZIP is not set

CONFIG_AUTOBOOT_CTRLC=y

CONFIG_ENV_OFFSET=0x80000
CONFIG_ENV_SIZE=0x1000

#
# SPL
#
CONFIG_SPL_NAND_SUPPORT=y
CONFIG_SYS_NAND_U_BOOT_OFFS=0x200000
CONFIG_NAND=y
CONFIG_SPL_NAND_INIT=y
CONFIG_SPL_SPI_SUPPORT=y
CONFIG_SPL_NAND_DRIVERS=y
CONFIG_SPL_NAND_IDENT=y
CONFIG_SPL_MTD_SUPPORT=y
CONFIG_SPL=y
CONFIG_SUPPORT_SPL=y
CONFIG_SPL_FRAMEWORK=y
CONFIG_SPL_TEXT_BASE=0x80fff800
CONFIG_SPL_LIBGENERIC_SUPPORT=y
CONFIG_SPL_SERIAL_SUPPORT=y
CONFIG_SPL_USE_ARCH_MEMCPY=y
CONFIG_SPL_USE_ARCH_MEMSET=y
CONFIG_SPL_LIBCOMMON_SUPPORT=y
CONFIG_SPL_BOARD_INIT=y
CONFIG_SPL_BANNER_PRINT=y
CONFIG_SPL_DM=y
CONFIG_SPL_SPI_DM=y
CONFIG_SPL_OF_LIBFDT=y
CONFIG_SPL_OF_CONTROL=y
CONFIG_SPL_OS_BOOT=y
CONFIG_SPL_SERIAL_PRESENT=y
CONFIG_SPL_CLK=y
CONFIG_SPL_CLK_CCF=y
CONFIG_SPL_PINCTRL=y
CONFIG_SPL_GPIO_SUPPORT=y
#
# SPL FIT support
#
# CONFIG_SPL_FIT is not set
# CONFIG_SPL_LOAD_FIT_SEPARATE is not set
```

## os/uboot/configs/ak3918av130_nor_spl_fast_defconfig
```kconfig
CONFIG_ANYKA=y
#CONFIG_Z1_H322D=y
CONFIG_FAST_LAUNCH=y
CONFIG_3918AV130_CODE=y
CONFIG_ARM=y
CONFIG_SYS_THUMB_BUILD=y
CONFIG_ARCH_AK3918AV130=y

CONFIG_SYS_TEXT_BASE=0x80dffa00
CONFIG_NR_DRAM_BANKS=1
CONFIG_PRE_CON_BUF_ADDR=0x80000000
CONFIG_PRE_CON_BUF_SZ=4096
CONFIG_BOOTSTAGE_STASH_ADDR=0
CONFIG_IDENT_STRING=""
# CONFIG_CMD_DEKBLOB is not set
# CONFIG_CMD_HDMIDETECT is not set
CONFIG_AK3918AV130=y
CONFIG_TARGET_ANYCLOUD_AK3918AV130=y
CONFIG_BOOTDELAY=1
CONFIG_SYS_MALLOC_CLEAR_ON_INIT=y

#
# Boot images
#
#CONFIG_FIT is not set
CONFIG_FIT_EXTERNAL_OFFSET=0x0
CONFIG_FIT_ENABLE_SHA256_SUPPORT is not set
# CONFIG_FIT_SIGNATURE is not set
# CONFIG_FIT_VERBOSE is not set
# CONFIG_FIT_BEST_MATCH is not set

#
# Hashing Support
#
CONFIG_SHA1 is not set
CONFIG_SHA256 is not set
# CONFIG_SHA_HW_ACCEL is not set
CONFIG_MD5 is not set

#
# Console
#
# CONFIG_CONSOLE_RECORD is not set
# CONFIG_DISABLE_CONSOLE is not set
# CONFIG_LOGLEVEL=4  is not set
# CONFIG_SPL_LOGLEVEL=4  is not set
# CONFIG_TPL_LOGLEVEL=4 is not set
# CONFIG_SILENT_CONSOLE is not set
CONFIG_PRE_CONSOLE_BUFFER=y
# CONFIG_CONSOLE_MUX is not set
# CONFIG_SYS_CONSOLE_IS_IN_ENV is not set
# CONFIG_SYS_CONSOLE_OVERWRITE_ROUTINE is not set
# CONFIG_SYS_CONSOLE_ENV_OVERWRITE is not set
# CONFIG_SYS_CONSOLE_INFO_QUIET is not set
# CONFIG_SYS_STDIO_DEREGISTER is not set
#CONFIG_DEFAULT_FDT_FILE="imx25-pdk.dtb" is not set
#
# Command line interface
#
CONFIG_CMDLINE=y
CONFIG_HUSH_PARSER=y
CONFIG_CMDLINE_EDITING=y
CONFIG_AUTO_COMPLETE=y
CONFIG_SYS_LONGHELP=y
CONFIG_SYS_PROMPT="=> "
CONFIG_SYS_XTRACE="y"
#

# Boot commands
#
# CONFIG_CMD_BOOTD is not set
CONFIG_CMD_BOOTM=y
# CONFIG_CMD_BOOTZ is not set
# CONFIG_EFI_LOADER is not set
# CONFIG_CMD_BOOTEFI is not set
# CONFIG_CMD_BOOTEFI_HELLO_COMPILE is not set
# CONFIG_CMD_BOOTEFI_HELLO is not set
# CONFIG_CMD_BOOTEFI_SELFTEST is not set
# CONFIG_CMD_BOOTMENU is not set
# CONFIG_CMD_DTIMG is not set
# CONFIG_CMD_ELF is not set
# CONFIG_CMD_FDT is not set
# CONFIG_CMD_EDITENV is not set
# CONFIG_ARCH_FIXUP_FDT_MEMORY is not set
CONFIG_CMD_GO=y
CONFIG_CMD_RUN=y
# CONFIG_CMD_IMI is not set
# CONFIG_CMD_IMLS is not set
# CONFIG_CMD_XIMG is not set
# CONFIG_CMD_FITUPD is not set
# CONFIG_CMD_THOR_DOWNLOAD is not set
# CONFIG_CMD_ZBOOT is not set
# CONFIG_CMD_FLASH is not set
# CONFIG_CMD_I2C is not set
# CONFIG_CMD_LOADS is not set
CONFIG_CMD_MMC=y
# CONFIG_CMD_PINMUX is not set
CONFIG_CMD_FAT=y
# CONFIG_CMD_ECHO is not set
# CONFIG_CMD_ITEST is not set
# CONFIG_CMD_SOURCE is not set
# CONFIG_CMD_SETEXPR is not set
# CONFIG_CMD_DHCP=y
# CONFIG_BOOTP_BOOTPATH is not set
# CONFIG_BOOTP_DNS is not set
# CONFIG_BOOTP_GATEWAY is not set
# CONFIG_BOOTP_HOSTNAME is not set
# CONFIG_BOOTP_SUBNETMASK is not set
# CONFIG_NET_TFTP_VARS is not set
# CONFIG_CMD_NFS is not set
# CONFIG_CMD_MII is not set
CONFIG_CMD_PING=y
CONFIG_CMD_CACHE=y
# CONFIG_CMD_MISC is not set
CONFIG_CMD_FS_GENERIC=y
#CONFIG_DOS_PARTITION is not set
CONFIG_SUPPORT_OF_CONTROL=y
CONFIG_DTC=y
#
# Device Tree Control
#
CONFIG_OF_CONTROL=y
# CONFIG_OF_EMBED is not set

CONFIG_MII=y
# CONFIG_FS_EXT4 is not set
CONFIG_FS_FAT=y
CONFIG_OF_LIBFDT=y
CONFIG_ENV_IS_IN_SPI_FLASH=y
#
#
# Generic Driver Options
#
CONFIG_DM=y
#CONFIG_DM_WARN is not set

CONFIG_DM_DEVICE_REMOVE=y
CONFIG_DM_STDIO=y
CONFIG_DM_SEQ_ALIAS=y

#CONFIG_SIMPLE_BUS is not set

#CONFIG_DM_DEV_READ_INLINE is not set

# MMC Host controller Support
#
CONFIG_MMC=y
# CONFIG_MMC_WRITE is not set
CONFIG_DM_MMC=y
# CONFIG_MMC_QUIRKS is not set
# CONFIG_MMC_HW_PARTITIONING is not set
# CONFIG_MMC_VERBOSE is not set
CONFIG_MMC_ANYKA=y

CONFIG_MTD_NOR_FLASH=y
#CONFIG_DM_SPI_FLASH is not set
CONFIG_SPI_FLASH=y

CONFIG_PHYLIB=y
CONFIG_DM_ETH=y
CONFIG_AK_ETH=y
CONFIG_PHY_SR8201F=y
CONFIG_PHY_JL1101=y
CONFIG_PHY_SZ18201=y

#
# Pin controllers
#
CONFIG_PINCTRL=y
CONFIG_PINCTRL_FULL=y
CONFIG_PINCTRL_GENERIC=y
CONFIG_PINMUX=y
CONFIG_PINCONF=y
CONFIG_PINCTRL_AK3918AV130=y
# CONFIG_PINCTRL_AT91 is not set
# CONFIG_PINCTRL_AT91PIO4 is not set
# CONFIG_PINCTRL_ROCKCHIP_RV1108 is not set
# CONFIG_PINCTRL_SINGLE is not set
# CONFIG_PINCTRL_STM32 is not set
# CONFIG_PINCTRL_STMFX is not set
#
# Serial drivers
#
CONFIG_BAUDRATE=115200
CONFIG_REQUIRE_SERIAL_CONSOLE=y
CONFIG_SPECIFY_CONSOLE_INDEX=y
CONFIG_SERIAL_PRESENT=y
CONFIG_CONS_INDEX=1
CONFIG_DM_SERIAL=y
CONFIG_AK_SERIAL=y
CONFIG_SPI_FLASH_MTD=y
CONFIG_SPI=y
CONFIG_AK_SPI=y
CONFIG_SPI_XFER_DMA=y
CONFIG_CMD_SF=y
CONFIG_DM_GPIO=y
CONFIG_AK3918AV130_GPIO=y
CONFIG_MTD=y
#CONFIG_DM_SPI is not set
CONFIG_SF_DEFAULT_SPEED=100000000
CONFIG_SF_DEFAULT_MODE=0x2403

CONFIG_SPI_FLASH_GIGADEVICE=y
CONFIG_SPI_FLASH_WINBOND=y
CONFIG_SPI_FLASH_MACRONIX=y
CONFIG_SPI_FLASH_FM=y
CONFIG_SPI_FLASH_BY=y
CONFIG_SPI_FLASH_ZB=y
CONFIG_SPI_FLASH_XT=y
CONFIG_SPI_FLASH_EON=y
CONFIG_SPI_FLASH_XMC=y
CONFIG_SPI_FLASH_PY=y
CONFIG_SPI_FLASH_GM=y
#CONFIG_SPI_FLASH_ME=y

#
# Clock framework
#
CONFIG_CLK=y
CONFIG_CLK_CCF=y
CONFIG_CLK_ANYKA_3918AV130=y


#
# mtdparts
#
CONFIG_CMD_MTDPARTS=y


#
# Graphics support
#
CONFIG_DM_VIDEO=n

CONFIG_VIDEO_BPP8=y
CONFIG_VIDEO_BPP16=y
CONFIG_VIDEO_BPP32=y

CONFIG_ANYKA_FB=y

#
# imgae LZMA(for sky platform)
#
CONFIG_LZMA=y

#
# autoboot key enter uboot cmd line
#
#CONFIG_AUTOBOOT_KEYED is not set
CONFIG_AUTOBOOT_DELAY_STR="123"
CONFIG_AUTOBOOT_STOP_STR="456"
# CONFIG_REGEX is not set
# CONFIG_GZIP is not set

CONFIG_AUTOBOOT_CTRLC=y


#CONFIG_ENV_OFFSET=0x38000
CONFIG_ENV_OFFSET=0x10000
CONFIG_ENV_SIZE=0x1000


#
# SPL
#
CONFIG_SPL=y
CONFIG_SUPPORT_SPL=y
CONFIG_SPL_FRAMEWORK=y
CONFIG_SPL_TEXT_BASE=0x80effa00
CONFIG_SPL_LIBGENERIC_SUPPORT=y
CONFIG_SPL_SERIAL_SUPPORT=y
CONFIG_SPL_USE_ARCH_MEMCPY=y
CONFIG_SPL_USE_ARCH_MEMSET=y
CONFIG_SPL_LIBCOMMON_SUPPORT=y
CONFIG_SPL_BOARD_INIT=y
CONFIG_SPL_BANNER_PRINT=y
#CONFIG_SPL_DM is not set
CONFIG_SPL_SPI_LOAD=y
CONFIG_SPL_SPI_FLASH_SUPPORT=y
CONFIG_SPL_SPI_SUPPORT=y
CONFIG_SYS_SPI_U_BOOT_OFFS=0x20000
CONFIG_SPL_OF_LIBFDT=y
CONFIG_SPL_OF_CONTROL=y
CONFIG_SPL_OS_BOOT=y
CONFIG_SPL_SERIAL_PRESENT=y
CONFIG_SPL_CLK=y
CONFIG_SPL_CLK_CCF=y
CONFIG_SPL_MTD_SUPPORT=y
CONFIG_SPL_PINCTRL=y
#CONFIG_SPL_GPIO_SUPPORT is not set
```
